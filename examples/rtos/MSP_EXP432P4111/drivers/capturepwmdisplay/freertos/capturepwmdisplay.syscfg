/*
 * Copyright (c) 2018-2019, Texas Instruments Incorporated
 * All rights reserved.
 *
 * Redistribution and use in source and binary forms, with or without
 * modification, are permitted provided that the following conditions
 * are met:
 *
 * *  Redistributions of source code must retain the above copyright
 *    notice, this list of conditions and the following disclaimer.
 *
 * *  Redistributions in binary form must reproduce the above copyright
 *    notice, this list of conditions and the following disclaimer in the
 *    documentation and/or other materials provided with the distribution.
 *
 * *  Neither the name of Texas Instruments Incorporated nor the names of
 *    its contributors may be used to endorse or promote products derived
 *    from this software without specific prior written permission.
 *
 * THIS SOFTWARE IS PROVIDED BY THE COPYRIGHT HOLDERS AND CONTRIBUTORS "AS IS"
 * AND ANY EXPRESS OR IMPLIED WARRANTIES, INCLUDING, BUT NOT LIMITED TO,
 * THE IMPLIED WARRANTIES OF MERCHANTABILITY AND FITNESS FOR A PARTICULAR
 * PURPOSE ARE DISCLAIMED. IN NO EVENT SHALL THE COPYRIGHT OWNER OR
 * CONTRIBUTORS BE LIABLE FOR ANY DIRECT, INDIRECT, INCIDENTAL, SPECIAL,
 * EXEMPLARY, OR CONSEQUENTIAL DAMAGES (INCLUDING, BUT NOT LIMITED TO,
 * PROCUREMENT OF SUBSTITUTE GOODS OR SERVICES; LOSS OF USE, DATA, OR PROFITS;
 * OR BUSINESS INTERRUPTION) HOWEVER CAUSED AND ON ANY THEORY OF LIABILITY,
 * WHETHER IN CONTRACT, STRICT LIABILITY, OR TORT (INCLUDING NEGLIGENCE OR
 * OTHERWISE) ARISING IN ANY WAY OUT OF THE USE OF THIS SOFTWARE,
 * EVEN IF ADVISED OF THE POSSIBILITY OF SUCH DAMAGE.
 */
// @cliArgs --board /ti/boards/MSP_EXP432P4111

/*
 *  capturepwmdisplay.syscfg
 */

/* ======== RTOS ======== */
var RTOS = scripting.addModule("/ti/drivers/RTOS");
RTOS.name = "FreeRTOS";

/* ======== Board ======== */
var board = system.deviceData.board.name;

/* ======== Capture ======== */
var Capture = scripting.addModule("/ti/drivers/Capture");
var capture = Capture.addInstance();
capture.$name = "CONFIG_CAPTURE_0";

if (board.match(/MSP.EXP432P/)) {
    capture.timer.capturePin.$assign = "P6.7";
    capture.clockDivider = 64;
} else if (board.match(/CC32..S/)) {
    capture.timer.capturePin.$assign = "P05";
}

/* ======== Display ======== */
var Display = scripting.addModule("/ti/display/Display");
var displayUART = Display.addInstance();
displayUART.$hardware = system.deviceData.board.components.XDS110UART;

/* ======== PWM ======== */
var PWM = scripting.addModule("/ti/drivers/PWM");
var pwm0 = PWM.addInstance();
var pwm1 = PWM.addInstance();
pwm0.$name = "CONFIG_PWM_0";
pwm1.$name = "CONFIG_PWM_1";

if (board.match(/MSP.EXP432P/)) {
    pwm0.$hardware = system.deviceData.board.components.LED1_PWM;
    pwm1.$hardware = system.deviceData.board.components.LED2_PWM;
} else if (board.match(/CC32..S/)) {
    pwm0.$hardware = system.deviceData.board.components.LED0_PWM;
    pwm1.$hardware = system.deviceData.board.components.LED1_PWM;
}
