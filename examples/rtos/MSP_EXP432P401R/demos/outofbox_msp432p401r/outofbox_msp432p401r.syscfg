/*
 * Copyright (c) 2018, Texas Instruments Incorporated
 * All rights reserved.
 *
 * Redistribution and use in source and binary forms, with or without
 * modification, are permitted provided that the following conditions
 * are met:
 *
 * *  Redistributions of source code must retain the above copyright
 *    notice, this list of conditions and the following disclaimer.
 *
 * *  Redistributions in binary form must reproduce the above copyright
 *    notice, this list of conditions and the following disclaimer in the
 *    documentation and/or other materials provided with the distribution.
 *
 * *  Neither the name of Texas Instruments Incorporated nor the names of
 *    its contributors may be used to endorse or promote products derived
 *    from this software without specific prior written permission.
 *
 * THIS SOFTWARE IS PROVIDED BY THE COPYRIGHT HOLDERS AND CONTRIBUTORS "AS IS"
 * AND ANY EXPRESS OR IMPLIED WARRANTIES, INCLUDING, BUT NOT LIMITED TO,
 * THE IMPLIED WARRANTIES OF MERCHANTABILITY AND FITNESS FOR A PARTICULAR
 * PURPOSE ARE DISCLAIMED. IN NO EVENT SHALL THE COPYRIGHT OWNER OR
 * CONTRIBUTORS BE LIABLE FOR ANY DIRECT, INDIRECT, INCIDENTAL, SPECIAL,
 * EXEMPLARY, OR CONSEQUENTIAL DAMAGES (INCLUDING, BUT NOT LIMITED TO,
 * PROCUREMENT OF SUBSTITUTE GOODS OR SERVICES; LOSS OF USE, DATA, OR PROFITS;
 * OR BUSINESS INTERRUPTION) HOWEVER CAUSED AND ON ANY THEORY OF LIABILITY,
 * WHETHER IN CONTRACT, STRICT LIABILITY, OR TORT (INCLUDING NEGLIGENCE OR
 * OTHERWISE) ARISING IN ANY WAY OUT OF THE USE OF THIS SOFTWARE,
 * EVEN IF ADVISED OF THE POSSIBILITY OF SUCH DAMAGE.
 */
// @cliArgs --board /ti/boards/MSP_EXP432P401R

/*
 *  outofbox_msp432p401r.syscfg
 */
/* ======== RTOS ======== */
var RTOS = scripting.addModule("/ti/drivers/RTOS");

/* ======== GPIO ======== */
var GPIO = scripting.addModule("/ti/drivers/GPIO");

var gpio0 = GPIO.addInstance();
gpio0.$hardware = system.deviceData.board.components.BUTTON0;
gpio0.$name = "CONFIG_GPIO_BUTTON0";
gpio0.interruptTrigger = "Falling Edge";
gpio0.pull = "Pull Up";

var gpio1 = GPIO.addInstance();
gpio1.$hardware = system.deviceData.board.components.BUTTON1;
gpio1.$name = "CONFIG_GPIO_BUTTON1";
gpio1.interruptTrigger = "Falling Edge";
gpio1.pull = "Pull Up";

var gpio2 = GPIO.addInstance();
gpio2.$hardware = system.deviceData.board.components.LED1_RED;
gpio2.$name = "CONFIG_GPIO_LED0";

/* ======== UART ======== */
var UART = scripting.addModule("/ti/drivers/UART");
var uart = UART.addInstance();
uart.$hardware = system.deviceData.board.components.XDS110UART;
uart.$name = "CONFIG_UART0";

/* ======== Timer ======== */
var Timer = scripting.addModule("/ti/drivers/Timer");

var Timer0 = Timer.addInstance();
Timer0.$name = "CONFIG_TIMER0";
Timer0.timerType = "32 Bits";
Timer0.timer.$assign = "TIMER32_0";

var Timer1 = Timer.addInstance();
Timer1.$name = "CONFIG_TIMER1";
Timer1.timerType = "32 Bits";
Timer1.timer.$assign = "TIMER32_1";

var Timer2 = Timer.addInstance();
Timer2.$name = "CONFIG_TIMER2";
Timer2.timer.$assign = "Timer_A2";

var Timer3 = Timer.addInstance();
Timer3.$name = "CONFIG_TIMER3";
Timer3.timer.$assign = "Timer_A3";

/* ======== PWM ======== */
var PWM = scripting.addModule("/ti/drivers/PWM");

var PWM1 = PWM.addInstance();
PWM1.$name = "CONFIG_PWM0";
PWM1.$hardware = system.deviceData.board.components.LED2_RED;
PWM1.timer.pwmPin.$assign = "16"; 

var PWM2 = PWM.addInstance();
PWM2.$name = "CONFIG_PWM1";
PWM2.$hardware = system.deviceData.board.components.LED2_GREEN;
PWM2.timer.pwmPin.$assign = "17"; 

var PWM3 = PWM.addInstance();
PWM3.$name = "CONFIG_PWM2";
PWM3.$hardware = system.deviceData.board.components.LED2_BLUE;
PWM3.timer.pwmPin.$assign = "18"; 
