/*
 * Copyright (c) 2018, Texas Instruments Incorporated
 * All rights reserved.
 *
 * Redistribution and use in source and binary forms, with or without
 * modification, are permitted provided that the following conditions
 * are met:
 *
 * *  Redistributions of source code must retain the above copyright
 *    notice, this list of conditions and the following disclaimer.
 *
 * *  Redistributions in binary form must reproduce the above copyright
 *    notice, this list of conditions and the following disclaimer in the
 *    documentation and/or other materials provided with the distribution.
 *
 * *  Neither the name of Texas Instruments Incorporated nor the names of
 *    its contributors may be used to endorse or promote products derived
 *    from this software without specific prior written permission.
 *
 * THIS SOFTWARE IS PROVIDED BY THE COPYRIGHT HOLDERS AND CONTRIBUTORS "AS IS"
 * AND ANY EXPRESS OR IMPLIED WARRANTIES, INCLUDING, BUT NOT LIMITED TO,
 * THE IMPLIED WARRANTIES OF MERCHANTABILITY AND FITNESS FOR A PARTICULAR
 * PURPOSE ARE DISCLAIMED. IN NO EVENT SHALL THE COPYRIGHT OWNER OR
 * CONTRIBUTORS BE LIABLE FOR ANY DIRECT, INDIRECT, INCIDENTAL, SPECIAL,
 * EXEMPLARY, OR CONSEQUENTIAL DAMAGES (INCLUDING, BUT NOT LIMITED TO,
 * PROCUREMENT OF SUBSTITUTE GOODS OR SERVICES; LOSS OF USE, DATA, OR PROFITS;
 * OR BUSINESS INTERRUPTION) HOWEVER CAUSED AND ON ANY THEORY OF LIABILITY,
 * WHETHER IN CONTRACT, STRICT LIABILITY, OR TORT (INCLUDING NEGLIGENCE OR
 * OTHERWISE) ARISING IN ANY WAY OUT OF THE USE OF THIS SOFTWARE,
 * EVEN IF ADVISED OF THE POSSIBILITY OF SUCH DAMAGE.
 */
// @cliArgs --board /ti/boards/MSP_EXP432P401R

/*
 *  cmsis_dsplib_oversample.syscfg
 */
/* ======== RTOS ======== */
var RTOS = scripting.addModule("/ti/drivers/RTOS");

/* ======== ADCBuf ======== */
var ADCBuf = scripting.addModule("/ti/drivers/ADCBuf");
var ADCBuf1 = ADCBuf.addInstance();
ADCBuf1.$name = "CONFIG_ADCBUF0";
ADCBuf1.adcBufChannel0.mode = "Differential";
ADCBuf1.adcBufChannel0.adc.adcPin.$assign = "boosterpack.29"; // P5.4
ADCBuf1.adcBufChannel0.differentialPin.adc.adcDifferentialPin.$assign = "boosterpack.30"; // P5.5

/* ======== Display ======== */
var Display = scripting.addModule("/ti/display/Display");
var Display1 = Display.addInstance();
Display1.$name = "CONFIG_Display0";
Display1.$hardware = system.deviceData.board.components.XDS110UART;
Display1.uart.$name = "CONFIG_UART0";

/* ======== GPIO ======== */
var GPIO = scripting.addModule("/ti/drivers/GPIO");
var GPIO1 = GPIO.addInstance();
var GPIO2 = GPIO.addInstance();
GPIO1.$name = "CONFIG_GPIO_LED1";
GPIO1.$hardware = system.deviceData.board.components.LED1_RED;
GPIO2.$name = "CONFIG_GPIO_BUTTON0";
GPIO2.$hardware = system.deviceData.board.components.S1;
GPIO2.interruptTrigger = "Falling Edge";
