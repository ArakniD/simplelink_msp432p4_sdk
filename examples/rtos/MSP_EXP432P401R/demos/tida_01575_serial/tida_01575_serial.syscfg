/*
 * Copyright (c) 2018, Texas Instruments Incorporated
 * All rights reserved.
 *
 * Redistribution and use in source and binary forms, with or without
 * modification, are permitted provided that the following conditions
 * are met:
 *
 * *  Redistributions of source code must retain the above copyright
 *    notice, this list of conditions and the following disclaimer.
 *
 * *  Redistributions in binary form must reproduce the above copyright
 *    notice, this list of conditions and the following disclaimer in the
 *    documentation and/or other materials provided with the distribution.
 *
 * *  Neither the name of Texas Instruments Incorporated nor the names of
 *    its contributors may be used to endorse or promote products derived
 *    from this software without specific prior written permission.
 *
 * THIS SOFTWARE IS PROVIDED BY THE COPYRIGHT HOLDERS AND CONTRIBUTORS "AS IS"
 * AND ANY EXPRESS OR IMPLIED WARRANTIES, INCLUDING, BUT NOT LIMITED TO,
 * THE IMPLIED WARRANTIES OF MERCHANTABILITY AND FITNESS FOR A PARTICULAR
 * PURPOSE ARE DISCLAIMED. IN NO EVENT SHALL THE COPYRIGHT OWNER OR
 * CONTRIBUTORS BE LIABLE FOR ANY DIRECT, INDIRECT, INCIDENTAL, SPECIAL,
 * EXEMPLARY, OR CONSEQUENTIAL DAMAGES (INCLUDING, BUT NOT LIMITED TO,
 * PROCUREMENT OF SUBSTITUTE GOODS OR SERVICES; LOSS OF USE, DATA, OR PROFITS;
 * OR BUSINESS INTERRUPTION) HOWEVER CAUSED AND ON ANY THEORY OF LIABILITY,
 * WHETHER IN CONTRACT, STRICT LIABILITY, OR TORT (INCLUDING NEGLIGENCE OR
 * OTHERWISE) ARISING IN ANY WAY OUT OF THE USE OF THIS SOFTWARE,
 * EVEN IF ADVISED OF THE POSSIBILITY OF SUCH DAMAGE.
 */
// @cliArgs --board /ti/boards/MSP_EXP432P401R

/*
 *  tida_01575_serial.syscfg
 */

/* ======== RTOS ======== */
var RTOS = scripting.addModule("/ti/drivers/RTOS");

/* ======== ADCBuf ======== */
var ADCBuf = scripting.addModule("/ti/drivers/ADCBuf");
var adcbuf = ADCBuf.addInstance();
adcbuf.$name = "CONFIG_ADCBUF0";
adcbuf.channels = 3;
adcbuf.adcBufChannel0.adc.adcPin.$assign = "P6.1";
adcbuf.adcBufChannel1.adc.adcPin.$assign = "P4.0";
adcbuf.adcBufChannel2.adc.adcPin.$assign = "P4.2";

/* ======== GPIO ======== */
var GPIO = scripting.addModule("/ti/drivers/GPIO");
var gpio0 = GPIO.addInstance();
gpio0.$name = "CONFIG_GPIO_BUTTON0";
gpio0.$hardware = system.deviceData.board.components.BUTTON0;
gpio0.interruptTrigger = "Falling Edge";
gpio0.pull = "Pull Up";

var gpio1 = GPIO.addInstance();
gpio1.$name = "CONFIG_GPIO_SENSORPWREN";
gpio1.$hardware = system.deviceData.board.components.LED1;
gpio1.mode = "Output";

var gpio2 = GPIO.addInstance();
gpio2.$name = "CONFIG_GPIO_SENSOREN";
gpio2.mode = "Output";
gpio2.gpioPin.$assign = "P3.7"; // P3.7

/* ======== Display ======== */
var Display = scripting.addModule("/ti/display/Display");
var displayUART = Display.addInstance();
displayUART.$hardware = system.deviceData.board.components.XDS110UART;

/* ======== Timer ======== */
var TIMER = scripting.addModule("/ti/drivers/Timer");
var timer = TIMER.addInstance();
timer.$name = "CONFIG_TIMER0";
timer.timerType = "32 Bits";
timer.timer.$assign = "TIMER32_0";
