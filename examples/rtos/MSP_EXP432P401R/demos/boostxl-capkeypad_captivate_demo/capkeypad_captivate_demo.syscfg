/*
 * Copyright (c) 2018, Texas Instruments Incorporated
 * All rights reserved.
 *
 * Redistribution and use in source and binary forms, with or without
 * modification, are permitted provided that the following conditions
 * are met:
 *
 * *  Redistributions of source code must retain the above copyright
 *    notice, this list of conditions and the following disclaimer.
 *
 * *  Redistributions in binary form must reproduce the above copyright
 *    notice, this list of conditions and the following disclaimer in the
 *    documentation and/or other materials provided with the distribution.
 *
 * *  Neither the name of Texas Instruments Incorporated nor the names of
 *    its contributors may be used to endorse or promote products derived
 *    from this software without specific prior written permission.
 *
 * THIS SOFTWARE IS PROVIDED BY THE COPYRIGHT HOLDERS AND CONTRIBUTORS "AS IS"
 * AND ANY EXPRESS OR IMPLIED WARRANTIES, INCLUDING, BUT NOT LIMITED TO,
 * THE IMPLIED WARRANTIES OF MERCHANTABILITY AND FITNESS FOR A PARTICULAR
 * PURPOSE ARE DISCLAIMED. IN NO EVENT SHALL THE COPYRIGHT OWNER OR
 * CONTRIBUTORS BE LIABLE FOR ANY DIRECT, INDIRECT, INCIDENTAL, SPECIAL,
 * EXEMPLARY, OR CONSEQUENTIAL DAMAGES (INCLUDING, BUT NOT LIMITED TO,
 * PROCUREMENT OF SUBSTITUTE GOODS OR SERVICES; LOSS OF USE, DATA, OR PROFITS;
 * OR BUSINESS INTERRUPTION) HOWEVER CAUSED AND ON ANY THEORY OF LIABILITY,
 * WHETHER IN CONTRACT, STRICT LIABILITY, OR TORT (INCLUDING NEGLIGENCE OR
 * OTHERWISE) ARISING IN ANY WAY OUT OF THE USE OF THIS SOFTWARE,
 * EVEN IF ADVISED OF THE POSSIBILITY OF SUCH DAMAGE.
 */
// @cliArgs --board /ti/boards/MSP_EXP432P401R

/*
 *  boostxl-capkeypad_captivate_demo.syscfg
 */
 
/* ======== RTOS ======== */
var RTOS = scripting.addModule("/ti/drivers/RTOS");

/* ======== GPIO ======== */
var GPIO = scripting.addModule("/ti/drivers/GPIO");
var gpio0 = GPIO.addInstance();
gpio0.$name = "CONFIG_GPIO_BUTTON0";
gpio0.$hardware = system.deviceData.board.components.S1;
gpio0.interruptTrigger = "Falling Edge";
gpio0.pull = "Pull Up";

var gpio1 = GPIO.addInstance();
gpio1.$name = "CONFIG_GPIO_LED1";
gpio1.$hardware = system.deviceData.board.components.LED2_RED;
gpio1.outputStrength = "Low";

var gpio2 = GPIO.addInstance();
gpio2.$name = "CONFIG_CAPTIVATE_IRQ";
gpio2.mode = "Input";
gpio2.interruptTrigger = "Rising Edge";
gpio2.pull = "Pull Up";
gpio2.gpioPin.$assign = "P4.5";
gpio2.callbackFunction = "NPI_irqHandler";

/* ======== I2C ======== */
var I2C = scripting.addModule("/ti/drivers/I2C");
var i2c0 = I2C.addInstance();
i2c0.$name = "CONFIG_I2C_CAPTIVATE";
i2c0.i2c.$assign = "EUSCI_B1";
i2c0.i2c.sdaPin.$assign = "P6.4"; 
i2c0.i2c.sclPin.$assign = "P6.5";  

/* ======== Display ======== */
var Display = scripting.addModule("/ti/display/Display");
var display = Display.addInstance();
display.$hardware = system.deviceData.board.components.XDS110UART;
